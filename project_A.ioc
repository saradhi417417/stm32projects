# file: project_A.ioc
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Mcu.Family=STM32F4
Mcu.Name=STM32F446R(C-E)Tx
Mcu.Package=LQFP64
NVIC.PriorityGroup=NVIC_PRIORITYGROUP_4
PA11.Signal=GPIO_Output
ProjectManager.HeapSize=0x200
ProjectManager.StackSize=0x400
ProjectManager.TargetToolchain=STM32CubeIDE
RCC.CortexFreq_Value=16000000
RCC.USBFreq_Value=96000000
RCC.VCOOutputFreq_Value=192000000
board=custom

// file: Core/Src/main.c
/* USER CODE BEGIN Header */
/**
  ******************************************************************************
  * @file           : main.c
  * @brief          : Main program body
  ******************************************************************************
  * @attention
  *
  * Copyright (c) 2025 STMicroelectronics.
  * All rights reserved.
  *
  * This software is licensed under terms that can be found in the LICENSE file
  * in the root directory of this software component.
  * If no LICENSE file comes with this software, it is provided AS-IS.
  *
  ******************************************************************************
  */
/* USER CODE END Header */
#include "main.h"
#include "../../Unity/unity.h"
#include "../../Unity/unity_internals.h"

int add(int a, int b);
int subtract(int a, int b);
extern void test_add_should_return_sum(void);
extern void test_subtract_should_return_difference(void);

void SystemClock_Config(void);
static void MX_GPIO_Init(void);

// Optional setup/teardown — Unity needs these even if empty
//void setUp(void) {}
//void tearDown(void) {}

int add(int a, int b) {
    return a + b;
}

int subtract(int a, int b) {
    return a - b;
}

//_sbrk();
//volatile int count=0;
//void cause_stack_overflow(int x)
//{
//    uint8_t buffer[100];  // Allocate some stack memory
//    count++;
//    buffer[0] = x;        // Just use it to prevent optimization
//
//    //cause_stack_overflow(x + 1);  // Recursive call with no base case!
//}

//const unsigned int data=234;

//void trigger_unaligned_access(void) {
//    uint32_t data = 0xDEADBEEF;
//    uint8_t *unaligned_ptr = (uint8_t *)&data + 1; // Create an unaligned pointer
//    uint32_t unaligned_data = *(uint32_t *)unaligned_ptr; // Unaligned access
//    (void)unaligned_data; // Use the value to avoid compiler warnings
//
//}
//void cause_hard_fault() {
//    volatile uint32_t *invalid_address = (uint32_t *)0xFFFFFFFF;  // Invalid memory access
//    *invalid_address = 0xDEADBEEF;  // This will cause a HardFault
//    //data=567;
//   (void) invalid_address;
//}

/*Pardha saradhi*/
/*1. pardha saradhi*/
int main(void)
{

	/*3. Pardha saradhi*/
	/*4, pardha saradhi*/
	/*5. pardha saradhi*/
	/*6.pardha saradhi*/

  /* MCU Configuration--------------------------------------------------------*/

  /* Reset of all peripherals, Initializes the Flash interface and the Systick. */
  HAL_Init();

  SCB->CCR |= SCB_CCR_UNALIGN_TRP_Msk;
  /*disable the write buffer by setting the DISDEFWBUF bit in the Auxiliary Control Register (ACTLR)*/
  SCnSCB->ACTLR |= SCnSCB_ACTLR_DISDEFWBUF_Msk;//SCB->CCR |= SCB_CCR_UNALIGN_TRP_Msk;

  /*UsageFault, BusFault, and MemManage faults are enabled*/
  SCB->SHCSR |= SCB_SHCSR_USGFAULTENA_Msk
               | SCB_SHCSR_BUSFAULTENA_Msk
               | SCB_SHCSR_MEMFAULTENA_Msk;
  /* Configure the system clock */
  SystemClock_Config();

  /* Initialize all configured peripherals */
  MX_GPIO_Init();

  /* Infinite loop */
  /* USER CODE BEGIN WHILE */

  //cause_hard_fault();
  //cause_stack_overflow(0);

  UNITY_BEGIN();
      RUN_TEST(test_add_should_return_sum);
      RUN_TEST(test_subtract_should_return_difference);
      // End Unity
  UNITY_END();

   add(3,10);
  subtract(10,20);

  //trigger_unaligned_access();

  while (1)
  {
    /* USER CODE END WHILE */

  }
}

void SystemClock_Config(void)
{
  RCC_OscInitTypeDef RCC_OscInitStruct = {0};
  RCC_ClkInitTypeDef RCC_ClkInitStruct = {0};

  /** Configure the main internal regulator output voltage
  */
  __HAL_RCC_PWR_CLK_ENABLE();
  __HAL_PWR_VOLTAGESCALING_CONFIG(PWR_REGULATOR_VOLTAGE_SCALE3);

  /** Initializes the RCC Oscillators according to the specified parameters
  * in the RCC_OscInitTypeDef structure.
  */
  RCC_OscInitStruct.OscillatorType = RCC_OSCILLATORTYPE_HSI;
  RCC_OscInitStruct.HSIState = RCC_HSI_ON;
  RCC_OscInitStruct.HSICalibrationValue = RCC_HSICALIBRATION_DEFAULT;
  RCC_OscInitStruct.PLL.PLLState = RCC_PLL_NONE;
  if (HAL_RCC_OscConfig(&RCC_OscInitStruct) != HAL_OK)
  {
    Error_Handler();
  }

  /** Initializes the CPU, AHB and APB buses clocks
  */
  RCC_ClkInitStruct.ClockType = RCC_CLOCKTYPE_HCLK|RCC_CLOCKTYPE_SYSCLK
                              |RCC_CLOCKTYPE_PCLK1|RCC_CLOCKTYPE_PCLK2;
  RCC_ClkInitStruct.SYSCLKSource = RCC_SYSCLKSOURCE_HSI;
  RCC_ClkInitStruct.AHBCLKDivider = RCC_SYSCLK_DIV1;
  RCC_ClkInitStruct.APB1CLKDivider = RCC_HCLK_DIV1;
  RCC_ClkInitStruct.APB2CLKDivider = RCC_HCLK_DIV1;

  if (HAL_RCC_ClockConfig(&RCC_ClkInitStruct, FLASH_LATENCY_0) != HAL_OK)
  {
    Error_Handler();
  }
}

static void MX_GPIO_Init(void)
{
  GPIO_InitTypeDef GPIO_InitStruct = {0};

  /* GPIO Ports Clock Enable */
  __HAL_RCC_GPIOA_CLK_ENABLE();

  /*Configure GPIO pin Output Level */
  HAL_GPIO_WritePin(GPIOA, GPIO_PIN_11, GPIO_PIN_RESET);

  /*Configure GPIO pin : PA11 */
  GPIO_InitStruct.Pin = GPIO_PIN_11;
  GPIO_InitStruct.Mode = GPIO_MODE_OUTPUT_PP;
  GPIO_InitStruct.Pull = GPIO_NOPULL;
  GPIO_InitStruct.Speed = GPIO_SPEED_FREQ_LOW;
  HAL_GPIO_Init(GPIOA, &GPIO_InitStruct);

}

void Error_Handler(void)
{
  __disable_irq();
  while (1)
  {
  }
}
